## meta-dream/conf/layer.conf
```bitbake
# We have a conf and classes directory, append to BBPATH
BBPATH .= ":${LAYERDIR}"

# We have a recipes directory, add to BBFILES
BBFILES += "${LAYERDIR}/recipes-*/*.bb ${LAYERDIR}/recipes-*/*.bbappend \
            ${LAYERDIR}/recipes-*/*/*.bb ${LAYERDIR}/recipes-*/*/*.bbappend \
            ${LAYERDIR}/recipes-*/*/*/*.bb ${LAYERDIR}/recipes-*/*/*/*.bbappend"

METADREAM_BASE := '${@os.path.normpath("${LAYERDIR}/../")}'
# Prevent current directory creeping into sstate objects. Otherwise, building
# in another TOPDIR will cause recipes using this variable to be rebuilt.
METADREAM_BASE[vardepvalue] = 'meta-dream'

BBFILE_COLLECTIONS += "meta-dream"
BBFILE_PATTERN_meta-dream := "^${LAYERDIR}/"
BBFILE_PRIORITY_meta-dream = "100"
LAYERSERIES_COMPAT_meta-dream = "kirkstone"

# OE optimization defaults to -O2 which makes for much larger binaries.
# Overridden here to use -Os instead, resulting in smaller images.
# Overridden here to use -O3 instead for better performance.
FULL_OPTIMIZATION = "-Os -pipe ${DEBUG_FLAGS}"
FULL_OPTIMIZATION:dm900 = "-O2 -pipe ${DEBUG_FLAGS}"
FULL_OPTIMIZATION:dm920 = "-O2 -pipe ${DEBUG_FLAGS}"

# Build glibc with -O2 to prevent of breaking the build of gobject-introspection.
O2_OPT = "-O2 -pipe ${DEBUG_FLAGS}"
FULL_OPTIMIZATION:pn-glibc = "${O2_OPT}"
FULL_OPTIMIZATION:pn-nativesdk-glibc = "${O2_OPT}"
FULL_OPTIMIZATION:pn-glibc-initial = "${O2_OPT}"
FULL_OPTIMIZATION:pn-nativesdk-glibc-initial = "${O2_OPT}"

# build some core libs with better compiler optimization for better performance
FULL_OPTIMIZATION:pn-flac = "${O2_OPT}"
FULL_OPTIMIZATION:pn-jpeg = "${O2_OPT}"
FULL_OPTIMIZATION:pn-lame = "${O2_OPT}"
FULL_OPTIMIZATION:pn-liba52 = "${O2_OPT}"
FULL_OPTIMIZATION:pn-libdca = "${O2_OPT}"
FULL_OPTIMIZATION:pn-libgcrypt = "${O2_OPT}"
FULL_OPTIMIZATION:pn-libmad = "${O2_OPT}"
FULL_OPTIMIZATION:pn-libogg = "${O2_OPT}"
FULL_OPTIMIZATION:pn-libpng = "${O2_OPT}"
FULL_OPTIMIZATION:pn-libsamplerate = "${O2_OPT}"
FULL_OPTIMIZATION:pn-libvorbis = "${O2_OPT}"
FULL_OPTIMIZATION:pn-tremor = "${O2_OPT}"
FULL_OPTIMIZATION:pn-zlib = "${O2_OPT}"
FULL_OPTIMIZATION:pn-elfutils = "${O2_OPT}"
```

## meta-dream/conf/machine/dm500hd.conf
```bitbake
#@TYPE: Machine
#@NAME: Dreambox DM500HD
#@DESCRIPTION: Machine configuration for the Dreambox DM500HD
#FLASHSIZE = "64"

OPENPLI_FEATURES = "fan usbconsole"
MACHINE_FEATURES += "modem wlan fan usbconsole libpassthrough blindscan-dvbc dreamboxv1 \
	no-nmap switchoff smallflash dvb-c hdmicec HDMI SCART ombv1 nolcd"

require conf/machine/include/dreambox-brcmnand.inc
require conf/machine/include/dreambox-nand-64mb.inc
require conf/machine/include/dreambox-part-64mb.inc
require conf/machine/include/dreambox-mips32el.inc

MACHINE_ESSENTIAL_EXTRA_RDEPENDS += "dm-bootsplash"

CHIPSET = "bcm7405"
SOC_FAMILY = "bcm7405"

# Image fails to boot if kernel exceeds some unknown limit, so make that
# explicit here. I don't know what the actual limit is, but 6416679 boots
# and 6604470 didn't.
KERNEL_IMAGE_MAXSIZE = "6500000"

IMAGE_FSTYPES = "jffs2"
IMAGE_CLASSES += "image_types_nfi"

# Add "dreamboxv1" override for recipes
MACHINEOVERRIDES .= ":dreamboxv1"
```

## meta-dream/conf/machine/dm500hdv2.conf
```bitbake
#@TYPE: Machine
#@NAME: Dreambox DM500HDv2
#@DESCRIPTION: Machine configuration for the Dreambox DM500HDv2
#FLASHSIZE = "96"

MACHINE_FEATURES += "fan usbconsole libpassthrough dvb-c blindscan-dvbc hdmicec HDMI SCART ombv1 nolcd"

require conf/machine/include/dreambox-hw-ecc.inc
require conf/machine/include/dreambox-nand-1024mb-2k.inc
require conf/machine/include/dreambox-part-1024mb.inc
require conf/machine/include/dreambox-mips32el.inc

MACHINE_ESSENTIAL_EXTRA_RDEPENDS += "dm-bootsplash"

CHIPSET = "bcm7405"
SOC_FAMILY = "bcm7405"

IMAGE_FSTYPES = "ubifs"
IMAGE_CLASSES += "image_types_nfi"
```

## meta-dream/conf/machine/dm520.conf
```bitbake
#@TYPE: Machine
#@NAME: Dreambox DM520
#@DESCRIPTION: Machine configuration for the Dreambox DM520
#FLASHSIZE = "512"

require conf/machine/include/mips/tune-mips32.inc

MACHINE_FEATURES += "v3d modem dvb-c blindscan-dvbc hdmicec recovery ci dvd HDMI"

CHIPSET = "bcm73625"
SOC_FAMILY = "bcm73625"
MTD_BLACK  = "mmcblk0"

BOX_BRAND = "dreambox"

TARGET_ARCH = "mipsel"
DEFAULTTUNE = "mips32el"
MTD_KERNEL = "mtd2"
KERNEL_FILE = "kernel.bin"
ROOTFS_FILE = "rootfs.bin"

MACHINE_FEATURES_BACKFILL_CONSIDERED += "rtc"

OPTIONAL_BSP_PACKAGES += "dreambox-buildimage"

EXTRA_IMAGEDEPENDS += "dreambox-secondstage-${MACHINE}"

MACHINE_EXTRA_RRECOMMENDS += " \
	gstreamer1.0-plugin-multibox-dvbmediasink \
	gstreamer1.0-libav \
	kernel-module-cifs \
	kernel-module-autofs4 \
	kernel-module-hmac \
	kernel-module-md4 \
	kernel-module-ecb \
	kernel-module-fuse \
	kernel-module-nfsd \
	kernel-module-exportfs \
	kernel-module-snd-oss \
	kernel-module-snd-pcm-oss \
	dreambox-boot-progress \
	${@bb.utils.contains('MACHINE_FEATURES', 'v3d', 'libvc5dream', '',d)} \
	"

MACHINE_ESSENTIAL_EXTRA_RDEPENDS += "\
	dreambox-dvb-modules-${MACHINE} \
	kernel-module-stv0299 \
	libpagecache \
	libpassthrough \
	"

GST_VERSION = "1.0"
	
MACHINE_FEATURES += "alsa usbhost switchoff dreambox"
# Add "dreambox" override for recipes
MACHINEOVERRIDES .= ":dreambox"

PREFERRED_PROVIDER_virtual/bootloader = "dreambox-secondstage-${MACHINE}"
PREFERRED_PROVIDER_virtual/kernel = "linux-dreambox"

PREFERRED_PROVIDER_virtual/blindscan-dvbs = "dreambox-blindscan-utils"
PREFERRED_PROVIDER_virtual/blindscan-dvbc = "dreambox-blindscan-utils"

KERNEL_IMAGETYPE = "vmlinux"
KERNEL_OUTPUT = "${KERNEL_IMAGETYPE}"
KERNEL_OUTPUT_DIR = "."
KERNEL_CONSOLE = "ttyS0,115200"

DVBMEDIASINK_CONFIG:dm520 = "--with-pcm --with-wma --with-wmv --with-dtsdownmix --with-eac3 --with-dts --with-vb6 --with-vb8 --with-spark --with-h265"

PREFERRED_PROVIDER_virtual/egl ?= "libvc5dream"
PREFERRED_PROVIDER_virtual/libgles1 ?= "libvc5dream"
PREFERRED_PROVIDER_virtual/libgles2 ?= "libvc5dream"
PREFERRED_PROVIDER_virtual/libgl ?= "mesa-gl"
PREFERRED_PROVIDER_virtual/mesa ?= "mesa-gl"
PREFERRED_PROVIDER_jpeg ?= "libjpeg-turbo"
PREFERRED_PROVIDER_jpeg-native ?= "libjpeg-turbo-native"
PREFERRED_VERSION_linux-dreambox = "3.4"

DISTRO_FEATURES_GFX:mipsel ?= " opengl"

PACKAGECONFIG:pn-glmark2 = "gles2"

PACKAGECONFIG:pn-cogl-1.0 = "egl-kms egl-null \
        ${@bb.utils.contains('DISTRO_FEATURES', 'opengl', 'gles2', '', d)}"

PACKAGECONFIG:pn-weston = "${@bb.utils.contains('DISTRO_FEATURES', 'opengl', 'gles', '', d)}"

DREAMBOX_IMAGE_SIZE ??= "1024"

IMAGE_FSTYPES = "tar.xz"
IMAGE_CLASSES += "image_types_tarxz"
```

## meta-dream/conf/machine/dm7020hd.conf
```bitbake
#@TYPE: Machine
#@NAME: Dreambox DM7020HD
#@DESCRIPTION: Machine configuration for the Dreambox DM7020HD and Dreambox DM7020HDv2
#FLASHSIZE = "96"

OPENPLI_FEATURES = "ci dvd usbconsole"
MACHINE_FEATURES += "modem wlan ci dvd usbconsole dvb-c blindscan-dvbc hdmicec \
	colorlcd128 dreamboxv1 grautec HDMI SCART RCA ombv1"

MACHINE_ESSENTIAL_EXTRA_RDEPENDS += "dm-bootsplash"

require conf/machine/include/dreambox-hw-ecc.inc
DM7020NANDINC = "${@ '1024mb-2k' if d.getVar('DMTYPE') else '1024mb'}"
require conf/machine/include/dreambox-nand-${DM7020NANDINC}.inc
require conf/machine/include/dreambox-part-1024mb.inc
require conf/machine/include/dreambox-mips32el.inc

CHIPSET = "bcm7405"
SOC_FAMILY = "bcm7405"

MACHINE_EXTRA_RRECOMMENDS += "dreambox-enigma2-config"

IMAGE_FSTYPES = "ubifs"
IMAGE_CLASSES += "image_types_nfi"

# Add "dreamboxv1" override for recipes
MACHINEOVERRIDES .= ":dreamboxv1"
```

## meta-dream/conf/machine/dm8000.conf
```bitbake
#@TYPE: Machine
#@NAME: Dreambox DM 8000 HD PVR
#@DESCRIPTION: Machine configuration for the Dreambox DM 8000 HD PVR
#FLASHSIZE = "96"

OPENPLI_FEATURES = "ci dvd"
MACHINE_FEATURES += "ombv1 ci dvd libpassthrough pci wlan colorlcd128 grautec \
	DVI SCART YUV RCA dvb-c blindscan-dvbc frontprocessor dreamboxv1 fan"

require conf/machine/include/dreambox-nand-256mb.inc
require conf/machine/include/dreambox-part-256mb.inc
require conf/machine/include/dreambox-mips32el.inc

CHIPSET = "bcm7400"
SOC_FAMILY = "bcm7400"

MACHINE_EXTRA_RRECOMMENDS += "dreambox-enigma2-config dreambox-bootlogo"

IMAGE_FSTYPES = "ubifs"
IMAGE_CLASSES += "image_types_nfi"

# Add "dreamboxv1" override for recipes
MACHINEOVERRIDES .= ":dreamboxv1"
```

## meta-dream/conf/machine/dm800se.conf
```bitbake
#@TYPE: Machine
#@NAME: Dreambox DM800se
#@DESCRIPTION: Machine configuration for the Dreambox DM800se
#FLASHSIZE = "64"

MACHINE_FEATURES += "ombv1 fan usbconsole libpassthrough no-nmap HDMI SCART \
		dvb-c blindscan-dvbc colorlcd bwlcd96 hdmicec switchoff smallflash"

require conf/machine/include/dreambox-brcmnand.inc
require conf/machine/include/dreambox-nand-64mb.inc
require conf/machine/include/dreambox-part-64mb.inc
require conf/machine/include/dreambox-mips32el.inc

MACHINE_ESSENTIAL_EXTRA_RDEPENDS += "dm-bootsplash"

CHIPSET = "bcm7405"
SOC_FAMILY = "bcm7405"

# Image fails to boot if kernel exceeds some unknown limit, so make that
# explicit here. I don't know what the actual limit is, but 6416679 boots
# and 6604470 didn't.
KERNEL_IMAGE_MAXSIZE = "6500000"

IMAGE_FSTYPES = "jffs2"
IMAGE_CLASSES += "image_types_nfi"
```

## meta-dream/conf/machine/dm800sev2.conf
```bitbake
#@TYPE: Machine
#@NAME: Dreambox DM800sev2
#@DESCRIPTION: Machine configuration for the Dreambox DM800sev2
#FLASHSIZE = "96"

MACHINE_FEATURES += "ombv1 dvb-c blindscan-dvbc hdmicec colorlcd fan \
			usbconsole libpassthrough no-nmap HDMI SCART"

require conf/machine/include/dreambox-hw-ecc.inc
require conf/machine/include/dreambox-nand-1024mb-2k.inc
require conf/machine/include/dreambox-part-1024mb.inc
require conf/machine/include/dreambox-mips32el.inc

MACHINE_ESSENTIAL_EXTRA_RDEPENDS += "dm-bootsplash"

CHIPSET = "bcm7405"
SOC_FAMILY = "bcm7405"

IMAGE_FSTYPES = "ubifs"
IMAGE_CLASSES += "image_types_nfi"
```

## meta-dream/conf/machine/dm900.conf
```bitbake
#@TYPE: Machine
#@NAME: Dreambox DM900
#@DESCRIPTION: Machine configuration for the Dreambox DM900
#FLASHSIZE = "4096"

MACHINE_FEATURES += "v3d dvb-c blindscan-dvbc hdmicec recovery ci dvd dreamboxv2 \
	ombv2 mmc emmc libpassthrough usbconsole colorlcd390 HDMI HDMI-IN-FHD"

CHIPSET = "bcm7252s"
SOC_FAMILY = "bcm7252s"

require conf/machine/include/dreambox-arm.inc
```

## meta-dream/conf/machine/dm920.conf
```bitbake
#@TYPE: Machine
#@NAME: Dreambox DM920
#@DESCRIPTION: Machine configuration for the Dreambox DM920
#FLASHSIZE = "8192"

MACHINE_FEATURES += "v3d dvb-c blindscan-dvbc hdmicec recovery ci dvd ombv2 \
	mmc emmc libpassthrough usbconsole colorlcd400 HDMI HDMI-IN-FHD dreamboxv2"

CHIPSET = "bcm7252s"
SOC_FAMILY = "bcm7252s"

require conf/machine/include/dreambox-arm.inc
```

## meta-dream/conf/machine/include/dreambox-mips32el.inc
```bitbake
# dreambox-mips32el.inc

BOX_BRAND = "dreambox"
TARGET_ARCH = "mipsel"
DEFAULTTUNE = "mips32el"
MTD_KERNEL = "mtd2"

KERNEL_FILE = "kernel.bin"
ROOTFS_FILE = "rootfs.bin"

MACHINE_EXTRA_RRECOMMENDS += "\
    ${@bb.utils.contains_any("MACHINE", "dm500hd dm800se", "", "gstreamer1.0-libav", d)} \
    "

MACHINE_ESSENTIAL_EXTRA_RDEPENDS += "\
    libpagecache \
    libpassthrough \
"

require conf/machine/include/dreambox.inc
require conf/machine/include/mips/tune-mips32.inc

MACHINE_KERNEL_PR = "r15"

DVBMEDIASINK_CONFIG = "--with-pcm --with-wma --with-wmv --with-dtsdownmix --with-eac3 --with-dts"
DVBMEDIASINK_CONFIG:dm8000 = "--with-pcm --with-wma --with-wmv --with-dtsdownmix --with-eac3 --with-dts --with-limited-mpeg4v2"
DVBMEDIASINK_CONFIG:dm7080 = "--with-pcm --with-wma --with-wmv --with-dtsdownmix --with-eac3 --with-dts --with-vb6 --with-vb8 --with-spark"
DVBMEDIASINK_CONFIG:dm820 = "--with-pcm --with-wma --with-wmv --with-dtsdownmix --with-eac3 --with-dts --with-vb6 --with-vb8 --with-spark"
DVBMEDIASINK_CONFIG:dm520 = "--with-pcm --with-wma --with-wmv --with-dtsdownmix --with-eac3 --with-dts --with-vb6 --with-vb8 --with-spark --with-h265"
```

## meta-dream/conf/machine/include/dreambox.inc
```bitbake
# dreambox.inc
# We know about rtc
MACHINE_FEATURES_BACKFILL_CONSIDERED += "rtc"

OPTIONAL_BSP_PACKAGES += "dreambox-buildimage"

EXTRA_IMAGEDEPENDS += "dreambox-secondstage-${MACHINE}"

# KERNEL_MODULE_AUTOLOAD += "xfs"

MACHINE_EXTRA_RRECOMMENDS += " \
	${@bb.utils.contains_any("MACHINE", "dm500hd dm800se", "", "gstreamer1.0-libav", d)} \
	gstreamer1.0-plugin-multibox-dvbmediasink \
	kernel-module-cifs \
	kernel-module-hmac \
	kernel-module-md4 \
	kernel-module-ecb \
	dreambox-boot-progress \
	"

MACHINE_ESSENTIAL_EXTRA_RDEPENDS += " \
	dreambox-dvb-modules-${MACHINE} \
	kernel-module-stv0299 \
	libpagecache \
	libpassthrough \
	"

GST_VERSION = "1.0"
	
MACHINE_FEATURES += "alsa usbhost dreambox"
# Add "dreambox" override for recipes
MACHINEOVERRIDES .= ":dreambox"

PREFERRED_PROVIDER_virtual/bootloader = "dreambox-secondstage-${MACHINE}"
PREFERRED_PROVIDER_virtual/kernel = "linux-dreambox"

PREFERRED_PROVIDER_virtual/blindscan-dvbs = "dreambox-blindscan-utils"
PREFERRED_PROVIDER_virtual/blindscan-dvbc = "dreambox-blindscan-utils"

PREFERRED_VERSION_linux-dreambox = "3.2"

KERNEL_IMAGETYPE = "vmlinux"
KERNEL_OUTPUT = "${KERNEL_IMAGETYPE}"
KERNEL_OUTPUT_DIR = "."
KERNEL_CONSOLE = "ttyS0,115200"

DREAMBOX_BUILDIMAGE = "buildimage --arch ${MACHINE} ${EXTRA_BUILDCMD} \
	--erase-block-size ${DREAMBOX_ERASE_BLOCK_SIZE} \
	--sector-size ${DREAMBOX_SECTOR_SIZE}"
```
