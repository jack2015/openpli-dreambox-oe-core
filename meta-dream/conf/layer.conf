## meta-openpli/conf/distro/openpli.conf
```bitbake
#@TYPE: Distribution
#@NAME: OpenPLi
#@DESCRIPTION: Embedded Linux Distribution Configuration for STB's

require reporefs.conf

DISTRO_FEATURES_BACKFILL_CONSIDERED += "pulseaudio"

DISTRO_NAME ?= "openpli"
DISTRO_HOST ?= "${@os.uname()[1]}"
DISTRO_VERSION ?= "10.3"
DISTRO_TYPE ?= "release"

IPKG_VARIANT = "opkg"
PACKAGE_DEBUG_SPLIT_STYLE = "debug-without-src"

INHERIT += "extrausers"
EXTRA_USERS_PARAMS = "usermod -P dreambox root;"

FEED_NAME ?= "${DISTRO_NAME}-${DISTRO_VERSION}"
DISTRO_FEED_URI ?= "http://${DISTRO_HOST}/feeds/${FEED_NAME}"
DISTRO_FEED_PREFIX ?= "${DISTRO_NAME}"

IMAGE_NAME = "${IMAGE_BASENAME}-${DISTRO_VERSION}-${MACHINE}"
IMAGE_LINK_NAME = ""
CACHE ?= "${TMPDIR}/cache/${LIBC}/${MACHINE}"
DEPLOY_DIR ?= "${TMPDIR}/deploy/${LIBC}"
DEPLOY_DIR_IMAGE = "${DEPLOY_DIR}/images/${MACHINE}"

VIRTUAL-RUNTIME_dev_manager = "busybox-mdev"
VIRTUAL-RUNTIME_login_manager = "busybox"
VIRTUAL-RUNTIME_init_manager = "sysvinit"
VIRTUAL-RUNTIME_initscripts = "initscripts"

PREFERRED_PROVIDER_virtual/enigma2-mediaservice ?= "enigma2-plugin-systemplugins-servicemp3"

PREFERRED_PROVIDERS += "virtual/${TARGET_PREFIX}gcc-initial:gcc-cross-initial"
PREFERRED_PROVIDERS += "virtual/${TARGET_PREFIX}gcc-intermediate:gcc-cross-intermediate"
PREFERRED_PROVIDERS += "virtual/${TARGET_PREFIX}gcc:gcc-cross"
PREFERRED_PROVIDERS += "virtual/${TARGET_PREFIX}g++:gcc-cross"

# Gstreamer 1.x
GST_VERSION = "1.0"

# python
PYTHON_PN = "python"
PYTHON_BASEVERSION = "2.7"
PREFERRED_VERSION_python = "2.7.18"
PREFERRED_VERSION_python-native = "2.7.18"

# other
PREFERRED_VERSION_tzdata = "2017b"
PREFERRED_VERSION_sdparm = "1.07"
PREFERRED_VERSION_mtd-utils = "2.0.0"
PREFERRED_VERSION_python-wifi = "0.6.1"
PREFERRED_VERSION_transmission = "3.00"
PREFERRED_VERSION_python-websocket-client = "0.59.0"

PREFERRED_PROVIDER_libcrypto ?= "openssl"
PREFERRED_PROVIDER_libssl ?= "openssl"
PREFERRED_RPROVIDER_libltdl ?= "libtool"
PREFERRED_RPROVIDER_ssh ?= "openssh"
PREFERRED_PROVIDER_libav ?= "ffmpeg"
PREFERRED_PROVIDER_python-pycrypto ?= "python-pycryptodome"

PREFERRED_VERSION_wpa-supplicant = "2.9"
PREFERRED_VERSION_directfb_arm = "1.7.7"
PREFERRED_VERSION_directfb-native_arm = "1.7.7"
PREFERRED_VERSION_directfb_aarch64 = "1.7.7"
PREFERRED_VERSION_directfb-native_aarch64 = "1.7.7"
PREFERRED_VERSION_libsoup-2.4 = "2.62.3"
PREFERRED_VERSION_libsdl2 = "2.0.14"
PREFERRED_VERSION_libsdl2_mipsel = "2.0.8"
PREFERRED_VERSION_libsdl2_mips = "2.0.8"

LICENSE_FLAGS_WHITELIST = "commercial"
COMMERCIAL_AUDIO_PLUGINS ?= "gstreamer1.0-plugins-good-audioparsers gstreamer1.0-plugins-good-mpg123"
COMMERCIAL_VIDEO_PLUGINS ?= "gstreamer1.0-plugins-ugly-mpeg2dec gstreamer1.0-plugins-bad-videoparsersbad gstreamer1.0-plugins-bad-mpegtsdemux gstreamer1.0-plugins-bad-mpegpsdemux"

# OE optimization defaults to -O2 which makes for much larger binaries.
# Overridden here to use -Os instead, resulting in smaller images.
# Overridden here to use -O3 instead for better performance.
FULL_OPTIMIZATION = "-Os -pipe ${DEBUG_FLAGS}"
FULL_OPTIMIZATION_dm900 = "-O2 -pipe ${DEBUG_FLAGS}"
FULL_OPTIMIZATION_dm920 = "-O2 -pipe ${DEBUG_FLAGS}"

DISTRO_FEATURES ?= "alsa bluetooth directfb ext2 largefile wifi nfs zeroconf mplt pam ${DISTRO_FEATURES_LIBC} ipv4 ipv6 tuxtxtfhd"

QA_LOG = "1"
QA_LOGFILE = "${TMPDIR}/qa.log"

OEINCLUDELOGS ?= "yes"
KERNEL_CONSOLE ?= "ttyS0,115200n8"

BB_GENERATE_MIRROR_TARBALLS ??= "0"

NO32LIBS ??= "1"

# Missing checksums should raise an error
BB_STRICT_CHECKSUM = "0"

# Place output in "tmp" as before, not "tmp-glibc"
TCLIBCAPPEND = ""

# Don't grab feeds for lower level archs, e.g. mips32el should not
# attempt to fetch mipsel, and armv7 need not fetch armv5 etcetera.
DISTRO_FEED_ARCHS = "all ${TUNE_PKGARCH} ${MACHINE_ARCH}"

# Use OpenSSL only
PACKAGECONFIG_pn-curl = "${@bb.utils.contains("DISTRO_FEATURES", "ipv6", "ipv6", "", d)} ssl proxy zlib libssh2"
PACKAGECONFIG_pn-openldap = "openssl modules mdb ldap meta monitor null passwd shell proxycache dnssrv ${@bb.utils.contains('DISTRO_FEATURES', 'ipv6', 'ipv6', '', d)}"
PACKAGECONFIG_pn-neon = "expat openssl libproxy webdav zlib"
```

## meta-openpli/conf/layer.conf
```bitbake
# We have a conf and classes directory, append to BBPATH
BBPATH .= ":${LAYERDIR}"

# We have a recipes directory, add to BBFILES
BBFILES += "${LAYERDIR}/recipes-*/*/*.bb ${LAYERDIR}/recipes-*/*/*.bbappend \
            ${LAYERDIR}/recipes-*/*/*/*.bb ${LAYERDIR}/recipes-*/*/*/*.bbappend"

BBFILE_COLLECTIONS += "openpli-layer"
BBFILE_PATTERN_openpli-layer := "^${LAYERDIR}/"
BBFILE_PRIORITY_openpli-layer = "7"

OPENPLI_BASE := '${@os.path.normpath("${LAYERDIR}/../")}'
# Prevent current directory creeping into sstate objects. Otherwise, building
# in another TOPDIR will cause recipes using this variable to be rebuilt.
OPENPLI_BASE[vardepvalue] = 'meta-openpli'

LICENSE_PATH += "${LAYERDIR}/licenses"

INSANE_SKIP:${PN} += "already-stripped ldflags"

#Include glib-gettextize, subversion and msgfmt(gettext) to hosttools
HOSTTOOLS += "glib-gettextize svn msgfmt python2 upx zip"

WARN_QA:remove = "patch-fuzz"
WARN_QA:remove = "build-deps"
WARN_QA:remove = "buildpaths"
ERROR_QA:remove = "file-rdeps"
ERROR_QA:remove = "ldflags"
ERROR_QA:remove = "debug-files"

LAYERSERIES_COMPAT_openpli-layer = "kirkstone"

I_SWEAR_TO_MIGRATE_TO_PYTHON3 = "yes"

# This prevents bitbake to fail at do_package caused by default OE-core split style variable setting
PACKAGE_DEBUG_SPLIT_STYLE = ""

MIRRORS += "\
ftp://.*/.*    http://openvix.co.uk/feeds_extras/sources-mirror/ \
http://.*/.*   http://openvix.co.uk/feeds_extras/sources-mirror/ \
https://.*/.*  http://openvix.co.uk/feeds_extras/sources-mirror/ \
ftp://.*/.*    http://source.mynonpublic.com/ \
http://.*/.*   http://source.mynonpublic.com/ \
https://.*/.*  http://source.mynonpublic.com/ \
ftp://.*/.*    http://code.vuplus.com/download/mirror/ \
http://.*/.*   http://code.vuplus.com/download/mirror/ \
https://.*/.*  http://code.vuplus.com/download/mirror/ \
ftp://.*/.*    http://autobuilder.yoctoproject.org/sources/ \
http://.*/.*   http://autobuilder.yoctoproject.org/sources/ \
https://.*/.*  http://autobuilder.yoctoproject.org/sources/ \
"

PREMIRRORS ?= "\
bzr://.*/.*   http://openvix.co.uk/feeds_extras/sources-mirror/ \
cvs://.*/.*   http://openvix.co.uk/feeds_extras/sources-mirror/ \
git://.*/.*   http://openvix.co.uk/feeds_extras/sources-mirror/ \
hg://.*/.*    http://openvix.co.uk/feeds_extras/sources-mirror/ \
osc://.*/.*   http://openvix.co.uk/feeds_extras/sources-mirror/ \
p4://.*/.*    http://openvix.co.uk/feeds_extras/sources-mirror/ \
svn://.*/.*   http://openvix.co.uk/feeds_extras/sources-mirror/ \
bzr://.*/.*   http://source.mynonpublic.com/ \
cvs://.*/.*   http://source.mynonpublic.com/ \
git://.*/.*   http://source.mynonpublic.com/ \
hg://.*/.*    http://source.mynonpublic.com/ \
osc://.*/.*   http://source.mynonpublic.com/ \
p4://.*/.*    http://source.mynonpublic.com/ \
svn://.*/.*   http://source.mynonpublic.com/ \
bzr://.*/.*   http://code.vuplus.com/download/mirror/ \
cvs://.*/.*   http://code.vuplus.com/download/mirror/ \
git://.*/.*   http://code.vuplus.com/download/mirror/ \
hg://.*/.*    http://code.vuplus.com/download/mirror/ \
osc://.*/.*   http://code.vuplus.com/download/mirror/ \
p4://.*/.*    http://code.vuplus.com/download/mirror/ \
svn://.*/.*   http://code.vuplus.com/download/mirror/ \
bzr://.*/.*   http://autobuilder.yoctoproject.org/sources/ \
cvs://.*/.*   http://autobuilder.yoctoproject.org/sources/ \
git://.*/.*   http://autobuilder.yoctoproject.org/sources/ \
hg://.*/.*    http://autobuilder.yoctoproject.org/sources/ \
osc://.*/.*   http://autobuilder.yoctoproject.org/sources/ \
p4://.*/.*    http://autobuilder.yoctoproject.org/sources/ \
svn://.*/.*   http://autobuilder.yoctoproject.org/sources/ \
"
```
